#include <Wire.h>
#include <Adafruit_GFX.h>
#include <Adafruit_SSD1306.h>
#include <PubSubClient.h>
#include <ESP8266WiFi.h>
#include <DHT.h>

static const unsigned char PROGMEM flowey_normal[4][63] =
{
  0x00, 0x00, 0x00, 0x03, 0x8e, 0x00, 0x06, 0x73, 0x00, 0x01, 0xfc, 0x00, 0x3b, 0xae, 0xe0, 0x7b, 
  0xfe, 0xf0, 0x3b, 0x76, 0xe0, 0x05, 0x8d, 0x00, 0x0e, 0xfb, 0x80, 0x1f, 0x07, 0xc0, 0x1f, 0xaf, 
  0xc0, 0x0e, 0x33, 0x80, 0x00, 0x30, 0x00, 0x00, 0x60, 0x00, 0x00, 0x40, 0x00, 0x00, 0x60, 0x00, 
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  0x00, 0x20, 0x00, 0x00, 0x30, 0x00, 0x00, 0x30, 0x00, 0x00, 0x70, 0x00, 0x00, 0x00, 0x00

};
static const unsigned char PROGMEM flowey_starve[4][63] =
{
  0x00, 0x00, 0x00, 0x01, 0x8c, 0x00, 0x02, 0x72, 0x00, 0x01, 0xfc, 0x00, 0x0d, 0xad, 0x80, 0x1d, 
  0xfd, 0xc0, 0x0d, 0xdd, 0x80, 0x05, 0xad, 0x00, 0x02, 0xfa, 0x00, 0x07, 0x07, 0x00, 0x07, 0xaf, 
  0x00, 0x02, 0x32, 0x00, 0x00, 0x20, 0x00, 0x00, 0x60, 0x00, 0x00, 0x40, 0x00, 0x00, 0x20, 0x00, 
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  0x00, 0x20, 0x00, 0x00, 0x20, 0x00, 0x00, 0x30, 0x00, 0x00, 0x70, 0x00, 0x00, 0x00, 0x00
};
static const unsigned char PROGMEM flowey_bored[4][63] =
{
  0x00, 0x00, 0x00, 0x03, 0x8e, 0x00, 0x06, 0x73, 0x00, 0x01, 0xfc, 0x00, 0x3b, 0xae, 0xe0, 0x7b, 
  0xfe, 0xf0, 0x3b, 0x06, 0xe0, 0x05, 0xfd, 0x00, 0x0e, 0xfb, 0x80, 0x1f, 0x07, 0xc0, 0x1f, 0xaf, 
  0xc0, 0x0e, 0x33, 0x80, 0x00, 0x30, 0x00, 0x00, 0x60, 0x00, 0x00, 0x40, 0x00, 0x00, 0x60, 0x00, 
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  0x00, 0x20, 0x00, 0x00, 0x30, 0x00, 0x00, 0x30, 0x00, 0x00, 0x70, 0x00, 0x00, 0x00, 0x00
};
static const unsigned char PROGMEM flowey_cold[4][63] =
{
  0x00, 0x00, 0x00, 0x00, 0x00, 0x00, 0x00, 0x00, 0x00, 0x01, 0xc7, 0x00, 0x03, 0x39, 0x80, 0x00, 
  0xfe, 0x00, 0x1d, 0xd7, 0x70, 0x3d, 0xff, 0x78, 0x1d, 0xd7, 0x70, 0x02, 0xaa, 0x80, 0x07, 0x7d, 
  0xc0, 0x0f, 0x83, 0xe0, 0x0f, 0xd7, 0xe0, 0x07, 0x19, 0xc0, 0x00, 0x18, 0x00, 0x00, 0x30, 0x00, 
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  0x00, 0x20, 0x00, 0x00, 0x30, 0x00, 0x00, 0x30, 0x00, 0x00, 0x70, 0x00, 0x00, 0x00, 0x00
};
static const unsigned char PROGMEM flowey_dead[63] =
{
  0x00, 0x00, 0x00, 0x00, 0x00, 0x00, 0x00, 0x78, 0x00, 0x03, 0x09, 0x00, 0x1e, 0x70, 0xc0, 0x3d, 
  0xf9, 0x40, 0x3b, 0xd9, 0x80, 0x1b, 0x8b, 0xb0, 0x03, 0xde, 0xd0, 0x09, 0xfc, 0x58, 0x1c, 0xfe, 
  0xd8, 0x1f, 0x0f, 0xb8, 0x0e, 0x27, 0x30, 0x0e, 0x60, 0x80, 0x00, 0xc7, 0xc0, 0x00, 0xe3, 0xc0, 
  0x00, 0x70, 0xc0, 0x00, 0x18, 0x00, 0x00, 0x38, 0x00, 0x00, 0x7c, 0x00, 0x00, 0x00, 0x00
};
static const unsigned char PROGMEM sun[4][57] =
{
  0x7b, 0xff, 0xe0, 0x03, 0xff, 0xe0, 0x1b, 0xde, 0xe0, 0xe3, 0xad, 0x60, 0x01, 0xff, 0xe0, 0x0d, 
  0xff, 0xe0, 0x31, 0xc0, 0x20, 0x40, 0xef, 0xa0, 0x02, 0xf7, 0x60, 0x0c, 0x78, 0xe0, 0x31, 0x3f, 
  0xe0, 0x02, 0x0f, 0xe0, 0x04, 0x40, 0xe0, 0x18, 0x90, 0x00, 0x20, 0x95, 0x20, 0x01, 0x25, 0x20, 
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  0x01, 0x12, 0x40, 0x02, 0x11, 0x20, 0x00, 0x01, 0x00
};
static const unsigned char PROGMEM sun_cold[4][57] =
{
  0x1b, 0xff, 0xe0, 0x03, 0xff, 0xe0, 0x1b, 0xff, 0xe0, 0x03, 0x8c, 0x60, 0x01, 0xff, 0xe0, 0x0d, 
  0xff, 0xe0, 0x01, 0xc0, 0x20, 0x00, 0xdf, 0xa0, 0x02, 0xff, 0xe0, 0x04, 0x7f, 0xe0, 0x01, 0x3f, 
  0xe0, 0x02, 0x0f, 0xe0, 0x00, 0x40, 0xe0, 0x00, 0x90, 0x00, 0x00, 0x15, 0x20, 0x00, 0x05, 0x20, 
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  0x00, 0x00, 0x00, 0x00, 0x00, 0x00, 0x00, 0x00, 0x00
};
static const unsigned char PROGMEM Home[4][100] =
{
  0x00, 0x00, 0x00, 0x00, 0x00, 0x00, 0x00, 0x00, 0x00, 0x00, 0x00, 0x00, 0xff, 0xff, 0xe0, 0x00, 
  0xee, 0xff, 0x90, 0x00, 0xff, 0xff, 0x08, 0x00, 0xbf, 0xbe, 0x64, 0x00, 0xc0, 0x7c, 0xf2, 0x00, 
  0xff, 0xf9, 0xf9, 0x00, 0xff, 0xf3, 0xfc, 0x00, 0xff, 0xe7, 0xfc, 0x00, 0x00, 0x0f, 0xfc, 0x28, 
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  0xff, 0xc0, 0x00, 0x00
};

static const unsigned char PROGMEM Home_dead[100] =
{
  0x00, 0x00, 0x00, 0x00, 0x00, 0x00, 0x00, 0x00, 0x00, 0x00, 0x00, 0x00, 0xff, 0xff, 0xe0, 0x00, 
  0xc4, 0x7f, 0x90, 0x00, 0xee, 0xff, 0x08, 0x00, 0xee, 0xfe, 0x64, 0x00, 0xff, 0xfc, 0xf2, 0x00, 
  0xe0, 0xf9, 0xf9, 0x00, 0xee, 0xf3, 0xfc, 0x00, 0xff, 0xe7, 0xfc, 0x00, 0x00, 0x0f, 0xfc, 0x00, 
  0xff, 0xdf, 0xfc, 0x00, 0xff, 0xdf, 0xfc, 0x40, 0x03, 0xdf, 0x9c, 0x80, 0xbb, 0xdf, 0x6d, 0x00, 
  0xbb, 0xdf, 0x6d, 0x00, 0x03, 0xdf, 0x2d, 0x14, 0xbb, 0xdf, 0x6c, 0x08, 0xbb, 0xdf, 0x68, 0x14, 
  0x03, 0xdf, 0x60, 0x00, 0xff, 0xdf, 0x00, 0x00, 0xff, 0xde, 0x00, 0x00, 0xff, 0xd8, 0x00, 0x00, 
  0xff, 0xc0, 0x00, 0x00,
};

static const unsigned char PROGMEM sun_dead[57] =
{
  0x03, 0xff, 0xe0, 0x03, 0xff, 0xe0, 0x03, 0x8c, 0x60, 0x03, 0xde, 0xe0, 0x01, 0xde, 0xe0, 0x01, 
  0xff, 0xe0, 0x01, 0xff, 0xe0, 0x00, 0xe0, 0xe0, 0x00, 0xee, 0xe0, 0x00, 0x7f, 0xe0, 0x00, 0x3f, 
  0xe0, 0x00, 0x0f, 0xe0, 0x00, 0x00, 0xe0, 0x00, 0x00, 0x00, 0x00, 0x00, 0x00, 0x00, 0x00, 0x00, 
  0x00, 0x00, 0x00, 0x00, 0x00, 0x00, 0x00, 0x00, 0x00
};

static const unsigned char PROGMEM poo[4][30] =
{
  0x00, 0x00, 0x00, 0x00, 0x00, 0x00, 0x00, 0x00, 0x00, 0x00, 0x01, 0x00, 0x03, 0x00, 0x06, 0x00, 
  0x00, 0x00, 0x00, 0x00, 0x04, 0x00, 0x0c, 0x00, 0x16, 0x00, 0x3d, 0x00, 0x6f, 0x80,
  0x00, 0x00, 0x00, 0x00, 0x00, 0x00, 0x10, 0x00, 0x0e, 0x00, 0x03, 0x00, 0x03, 0x00, 0x06, 0x00, 
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  0x00, 0x00, 0x00, 0x00, 0x04, 0x00, 0x0c, 0x00, 0x16, 0x00, 0x3d, 0x00, 0x6f, 0x80
};

static const unsigned char PROGMEM text_bored[96] =
{
  0x3f, 0xff, 0xff, 0xff, 0xff, 0xff, 0xff, 0xff, 0xff, 0xff, 0xff, 0xf8, 0x7f, 0xff, 0xff, 0xc6, 
  0xff, 0xfd, 0xff, 0xff, 0xff, 0xbf, 0xff, 0xfc, 0xff, 0xff, 0xff, 0xef, 0xff, 0xfd, 0xff, 0xff, 
  0x9f, 0xbf, 0xff, 0xfe, 0xff, 0xff, 0xff, 0xef, 0x81, 0xfc, 0x39, 0xd7, 0x6c, 0x3f, 0xff, 0xfe, 
  0xff, 0xff, 0xff, 0xef, 0xb6, 0xfd, 0xb6, 0xcb, 0x0d, 0xbf, 0xff, 0xfe, 0xff, 0xff, 0xff, 0xef, 
  0xb6, 0xfd, 0xb6, 0xdf, 0x7d, 0xbf, 0xff, 0xfe, 0x7f, 0xff, 0xff, 0xc7, 0xb6, 0xfc, 0x39, 0xdf, 
  0x9c, 0x3f, 0xff, 0xfc, 0x3f, 0xff, 0xff, 0xff, 0xff, 0xff, 0xff, 0xff, 0xff, 0xff, 0xff, 0xf8
};

static const unsigned char PROGMEM text_hungry[96] =
{
  0x3f, 0xff, 0xff, 0xff, 0xff, 0xff, 0xff, 0xff, 0xff, 0xff, 0xff, 0xf8, 0x7f, 0xff, 0xfc, 0x6f, 
  0xff, 0xdd, 0xff, 0xff, 0x3f, 0xff, 0xff, 0xfc, 0xff, 0xff, 0xfe, 0xff, 0xff, 0xdd, 0xff, 0xfe, 
  0xbf, 0xbb, 0xff, 0xfe, 0xff, 0xff, 0xfe, 0xf8, 0x1f, 0xc1, 0xbb, 0x37, 0x35, 0xdb, 0xff, 0xfe, 
  0xff, 0xff, 0xfe, 0xfb, 0x6f, 0xdd, 0xbb, 0x57, 0xb2, 0xe7, 0xff, 0xfe, 0xff, 0xff, 0xfe, 0xfb, 
  0x6f, 0xdd, 0xbb, 0x66, 0xb7, 0xf7, 0xff, 0xfe, 0x7f, 0xff, 0xfc, 0x7b, 0x6f, 0xdd, 0x83, 0x76, 
  0x77, 0xef, 0xff, 0xfc, 0x3f, 0xff, 0xff, 0xff, 0xff, 0xff, 0xff, 0xff, 0xff, 0xff, 0xff, 0xf8

};

static const unsigned char PROGMEM text_cold[96] =
{
  0x3f, 0xff, 0xff, 0xff, 0xff, 0xff, 0xff, 0xff, 0xff, 0xff, 0xff, 0xf8, 0x7f, 0xff, 0xff, 0xf8, 
  0xdf, 0xff, 0xff, 0xf7, 0xdf, 0xff, 0xff, 0xfc, 0xff, 0xff, 0xff, 0xfd, 0xff, 0xff, 0xcf, 0xf7, 
  0xdf, 0xff, 0xff, 0xfe, 0xff, 0xff, 0xff, 0xfd, 0xf0, 0x3f, 0xbe, 0x76, 0x1f, 0xff, 0xff, 0xfe, 
  0xff, 0xff, 0xff, 0xfd, 0xf6, 0xdf, 0xbd, 0xb6, 0xdf, 0xff, 0xff, 0xfe, 0xff, 0xff, 0xff, 0xfd, 
  0xf6, 0xdf, 0xbd, 0xb6, 0xdf, 0xff, 0xff, 0xfe, 0x7f, 0xff, 0xff, 0xf8, 0xf6, 0xdf, 0xce, 0x76, 
  0x1f, 0xff, 0xff, 0xfc, 0x3f, 0xff, 0xff, 0xff, 0xff, 0xff, 0xff, 0xff, 0xff, 0xff, 0xff, 0xf8
};

static const unsigned char PROGMEM text_poop[96] =
{
  0x3f, 0xff, 0xff, 0xff, 0xff, 0xff, 0xff, 0xff, 0xff, 0xff, 0xff, 0xf8, 0x7f, 0xff, 0xf1, 0xbf, 
  0xff, 0x1f, 0xff, 0xc7, 0xff, 0xbf, 0xff, 0xfc, 0xff, 0xff, 0xfb, 0xff, 0xff, 0x6f, 0xff, 0xdb, 
  0x9f, 0xbf, 0xff, 0xfe, 0xff, 0xff, 0xfb, 0xe0, 0x7f, 0x6e, 0x79, 0xdb, 0x6c, 0x3f, 0xff, 0xfe, 
  0xff, 0xff, 0xfb, 0xed, 0xbf, 0x1d, 0xb6, 0xc7, 0x0d, 0xbf, 0xff, 0xfe, 0xff, 0xff, 0xfb, 0xed, 
  0xbf, 0x7d, 0xb6, 0xdf, 0x7d, 0xbf, 0xff, 0xfe, 0x7f, 0xff, 0xf1, 0xed, 0xbf, 0x7e, 0x79, 0xdf, 
  0x9c, 0x3f, 0xff, 0xfc, 0x3f, 0xff, 0xff, 0xff, 0xff, 0xff, 0xff, 0xff, 0xff, 0xff, 0xff, 0xf8
};

static const unsigned char PROGMEM text_dead[96] =
{
  0x3f, 0xff, 0xff, 0xff, 0xff, 0xff, 0xff, 0xff, 0xff, 0xff, 0xff, 0xf8, 0x46, 0xff, 0xff, 0xbf, 
  0xff, 0xf7, 0xc7, 0x7f, 0xff, 0xff, 0xff, 0xfc, 0xef, 0xff, 0xff, 0xb9, 0xff, 0xf7, 0xdb, 0x61, 
  0xff, 0xe7, 0x9c, 0xe2, 0xef, 0x81, 0xfc, 0x36, 0xf3, 0x87, 0xdb, 0x79, 0xf5, 0xdb, 0x7b, 0x76, 
  0xef, 0xb6, 0xfd, 0xb0, 0xeb, 0xb7, 0xc7, 0x73, 0xf2, 0xc3, 0x18, 0x76, 0xef, 0xb6, 0xfd, 0xb7, 
  0xdb, 0xb7, 0xdf, 0x67, 0xf7, 0xdf, 0xdb, 0xf6, 0x47, 0xb6, 0xfc, 0x39, 0xc1, 0x86, 0xdf, 0x61, 
  0xf7, 0xe7, 0x3c, 0xf4, 0x3f, 0xff, 0xff, 0xff, 0xff, 0xff, 0xff, 0xff, 0xff, 0xff, 0xff, 0xf8
};


#define DHTTYPE DHT22
#define DHTPIN 14

DHT dht(DHTPIN,DHTTYPE,11);

#define SCREEN_WIDTH 128 // OLED display width, in pixels
#define SCREEN_HEIGHT 32 // OLED display height, in pixels

#define OLED_RESET    -1 // Reset pin # (or -1 if sharing Arduino reset pin)
Adafruit_SSD1306 display(SCREEN_WIDTH, SCREEN_HEIGHT, &Wire, OLED_RESET);

#define IMAGE_MOVE 300L
#define SEC 2000L
#define tempInterval 1000L
const char* ssid = "IoT518";
const char* password = "iot123456";
const char* mqttServer= "54.159.204.45";
const int mqttPort = 1883;
const char* topic_json = "/sensor/json/";

unsigned long prevTime[5] = {0L,};
unsigned long currentTime = 0L;
char toController[100];
unsigned int count = 0;
unsigned char sec_cnt = 0;
unsigned char min_cnt = 1;
unsigned char dead_cnt = 0;
unsigned char stove_cnt = 0;
unsigned char stove_flag = 0;
char rand_disc_starve = 0;
char rand_disc_play = 0;
char rand_disc_temp = 0;
unsigned int lastm = 0;
float tempr = 0;
float humi = 0;
unsigned int light = 0;
int rand_cnt[3] = {2,3,3};
unsigned char rand_flag = 1;
int temp = 0;
unsigned char starve = 30; unsigned char play = 30; unsigned char poop = 0; unsigned char stove = 30; unsigned char dead = 0;unsigned char Reset = 0;

WiFiClient espClient;
PubSubClient client(espClient);

void setup() {
    Serial.begin(115200);
      if(!display.begin(SSD1306_SWITCHCAPVCC, 0x3C)) { // Address 0x3C for 128x32
        Serial.println(F("SSD1306 allocation failed"));
       for(;;); 
    }
    display.display();
    display.clearDisplay();
     
     WiFi.begin(ssid, password);

     
     while (WiFi.status() != WL_CONNECTED) {
       delay(500);
       Serial.println("Connecting to WiFi..");
     }
     
     Serial.println("Connected to the WiFi network");

     client.setServer(mqttServer, mqttPort);
     
     while (!client.connected()) {
      
        Serial.println("Connecting to MQTT...");
        if (client.connect("ESP8266Client")) {
            Serial.println("connected");
        } else {
            Serial.print("failed with state "); Serial.println(client.state());
         delay(2000);
        }
      }
      client.subscribe("/sensor/ctl/");
      client.setCallback(callback);
      
}
//CLEAN//FEED//RESET//PLAY//STOVE
void callback(char* topic, byte* payload, unsigned int length) {

      char comp[3] = {payload[0],payload[1],'\0'};
      Serial.println(comp);
      
      if(!(strcmp(comp,"FE"))){
        rand_cnt[0] = 0;
        rand_disc_starve = 0;
        starve = 30;
      }
      if(!(strcmp(comp,"PL"))){
        rand_cnt[1] = 0;
        rand_disc_play = 0;
        play = 30;
      }
      if(!(strcmp(comp,"ST"))){
        stove_flag = 1;
        rand_cnt[2] = 0;
        rand_disc_temp = 0;
        stove = 30;
      }
      if(!(strcmp(comp,"CL"))){
        rand_cnt[3] = 0;
        poop = 0;
      }
      if(!(strcmp(comp,"RE"))){
        dead = 0;
        rand_cnt[4] = {0,};
        starve = 30;
        play = 30;
        stove = 30;
        poop = 0;
      }
}

    
void gettemp(){
  unsigned long currentm = millis();
  if(currentm - lastm > tempInterval){
    lastm = currentm;
    tempr = dht.readTemperature();
    humi = dht.readHumidity();
    if(isnan(tempr)){
      return;
    }
  }
}

//"{\'HUNGER\':%d,\'PLAY\':%d,\'TEMP\':%d,\'HUM\':%d,\'POO\':%d}"
//rand_cnt 0=hunger, 1=play, 2=poop

void loop() {
    client.loop();
    gettemp();
    unsigned long currentTime = millis();
    
    if(dead == 1){
      if(currentTime > prevTime[2] + SEC) {
          dead_cnt++;
          client.publish(topic_json,"1");
          if(dead_cnt > 1) dead_cnt = 0;
          prevTime[2] = currentTime;
        }
        
    }
    else{
      
      if(currentTime > prevTime[0] + IMAGE_MOVE) {
          count++;
          if(count > 3) count = 0;
          prevTime[0] = currentTime;   
      }
      
      if(currentTime > prevTime[1] + SEC) {
          sec_cnt++;
         
          if(sec_cnt == 20){
            sec_cnt = 0;
            if(stove_flag){
              stove_cnt++;
              rand_disc_temp = 0;
            }
            else if(tempr < 10)rand_disc_temp = -1;
            if(rand_cnt[0] == min_cnt)rand_disc_starve = -1;
            if(rand_cnt[1] == min_cnt)rand_disc_play = -1;
            if(rand_cnt[2] == min_cnt)poop++;
            min_cnt++;
          }
            if(stove_cnt == 5){
              stove_cnt = 0;
              stove_flag = 0;
            }
          if(min_cnt == 4){
            srand(currentTime);
            if(rand_disc_starve == 0)rand_cnt[0] = rand()%4+1;
            else rand_cnt[0] = rand_cnt[0];
            if(rand_disc_play == 0)rand_cnt[1] = rand()%4+1;
            else rand_cnt[1] = rand_cnt[1];
            if(stove_cnt)rand_disc_temp = 0;
            rand_cnt[2] = rand()%4+1;
            min_cnt = 1;
          }
          light = analogRead(A0);
          starve = starve + rand_disc_starve;
          play = play + rand_disc_play;
          stove = stove + rand_disc_temp;
  
          if(starve == 0||play == 0||poop == 3||stove == 0)dead = 1;

          sprintf(toController,"{\'HUNGER\':%d,\'PLAY\':%d,\'TEMP\':%.2f,\'HUM\':%.2f,\'Cds\':%d,\'POO\':%d}",starve,play,tempr,humi,light,poop);
          client.publish(topic_json,toController);

          /*
          Serial.println(rand_cnt[0]);
          Serial.println(rand_cnt[1]);
          Serial.println(rand_cnt[2]);
          Serial.println(rand_disc_starve);
          Serial.println(rand_disc_play);
          Serial.println(rand_disc_temp);
          Serial.println(starve);
          Serial.println(play);
          Serial.println(stove);
          */
          
          prevTime[1] = currentTime;
    }
  }
    display.clearDisplay();
    if(dead==1){
      display.drawBitmap(59, 0, flowey_dead, 21, 21, SSD1306_WHITE);
      display.drawBitmap(108,0,sun_dead,19,19,SSD1306_WHITE);
      display.drawBitmap(0,0,Home_dead,30,25,SSD1306_WHITE);
      display.drawBitmap(21, 24, text_dead, 95, 8, SSD1306_BLACK);
      display.drawBitmap(21, 24, text_dead, 95, 8, SSD1306_WHITE);
    }
    else{
      if(starve == 30&&play==30&&stove == 30){
        display.drawBitmap(59, 0, flowey_normal[count], 21, 21, SSD1306_WHITE);
        display.drawBitmap(21, 24, text_dead, 95, 8, SSD1306_BLACK);
      }
 
      if(!(starve==30)){
        display.drawBitmap(59, 0, flowey_starve[count], 21, 21, SSD1306_WHITE);
        display.drawBitmap(21, 24, text_dead, 95, 8, SSD1306_BLACK);
        display.drawBitmap(21, 24, text_hungry, 95, 8, SSD1306_WHITE);
      }
      else if(!(play==30)){
        display.drawBitmap(59, 0, flowey_bored[count], 21, 21, SSD1306_WHITE);
        display.drawBitmap(21, 24, text_dead, 95, 8, SSD1306_BLACK);
        display.drawBitmap(21, 24, text_bored, 95, 8, SSD1306_WHITE);
      }
      else if(!(stove==30)){
        display.drawBitmap(59, 0, flowey_cold[count], 21, 21, SSD1306_WHITE);
        display.drawBitmap(21, 24, text_dead, 95, 8, SSD1306_BLACK);
        display.drawBitmap(21, 24, text_cold, 95, 8, SSD1306_WHITE);
      }
      
      if(stove == 30){
        display.drawBitmap(108,0,sun[count/2],19,19,SSD1306_WHITE);
      }
      else display.drawBitmap(108,0,sun_cold[count/2],19,19,SSD1306_WHITE);
  
      if(poop == 1){
        display.drawBitmap(45, 6, poo[count], 10, 15, SSD1306_WHITE);
      }
      if(poop == 2){
        display.drawBitmap(45, 6, poo[count], 10, 15, SSD1306_WHITE);
        display.drawBitmap(89, 6, poo[count], 10, 15, SSD1306_WHITE);
      }
     
      display.drawBitmap(0,0,Home[count/2],30,25,SSD1306_WHITE);
    }
   
    
    display.display(); 
    delay(10);

}
